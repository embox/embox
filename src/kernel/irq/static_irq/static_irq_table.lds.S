#include "irq_static.h"

#define SIRQ_TABLE_ENTRY(n) \
	. = DEFINED(STATIC_IRQ_HANDLER_VAR_NAME(n)) ? (n) * 4 : .; \
	*(STATIC_IRQ_HANDLER_SECTION(n)); \

SECTIONS {
	.static_irq_table : {
		SIRQ_TABLE_ENTRY(0)
		SIRQ_TABLE_ENTRY(1) SIRQ_TABLE_ENTRY(2)
		SIRQ_TABLE_ENTRY(3) SIRQ_TABLE_ENTRY(4)
		SIRQ_TABLE_ENTRY(5) SIRQ_TABLE_ENTRY(6)
		SIRQ_TABLE_ENTRY(7) SIRQ_TABLE_ENTRY(8)
		SIRQ_TABLE_ENTRY(9) SIRQ_TABLE_ENTRY(10)
		SIRQ_TABLE_ENTRY(11) SIRQ_TABLE_ENTRY(12)
		SIRQ_TABLE_ENTRY(13) SIRQ_TABLE_ENTRY(14)
		SIRQ_TABLE_ENTRY(15) SIRQ_TABLE_ENTRY(16)
		SIRQ_TABLE_ENTRY(17) SIRQ_TABLE_ENTRY(18)
		SIRQ_TABLE_ENTRY(19) SIRQ_TABLE_ENTRY(20)
		SIRQ_TABLE_ENTRY(21) SIRQ_TABLE_ENTRY(22)
		SIRQ_TABLE_ENTRY(23) SIRQ_TABLE_ENTRY(24)
		SIRQ_TABLE_ENTRY(25) SIRQ_TABLE_ENTRY(26)
		SIRQ_TABLE_ENTRY(27) SIRQ_TABLE_ENTRY(28)
		SIRQ_TABLE_ENTRY(29) SIRQ_TABLE_ENTRY(30)
		SIRQ_TABLE_ENTRY(31) SIRQ_TABLE_ENTRY(32)
		SIRQ_TABLE_ENTRY(33) SIRQ_TABLE_ENTRY(34)
		SIRQ_TABLE_ENTRY(35) SIRQ_TABLE_ENTRY(36)
		SIRQ_TABLE_ENTRY(37) SIRQ_TABLE_ENTRY(38)
		SIRQ_TABLE_ENTRY(39) SIRQ_TABLE_ENTRY(40)
		SIRQ_TABLE_ENTRY(41) SIRQ_TABLE_ENTRY(42)
		SIRQ_TABLE_ENTRY(43) SIRQ_TABLE_ENTRY(44)
		SIRQ_TABLE_ENTRY(45) SIRQ_TABLE_ENTRY(46)
		SIRQ_TABLE_ENTRY(47) SIRQ_TABLE_ENTRY(48)
		SIRQ_TABLE_ENTRY(49) SIRQ_TABLE_ENTRY(50)
		SIRQ_TABLE_ENTRY(51) SIRQ_TABLE_ENTRY(52)
		SIRQ_TABLE_ENTRY(53) SIRQ_TABLE_ENTRY(54)
		SIRQ_TABLE_ENTRY(55) SIRQ_TABLE_ENTRY(56)
		SIRQ_TABLE_ENTRY(57) SIRQ_TABLE_ENTRY(58)
		SIRQ_TABLE_ENTRY(59) SIRQ_TABLE_ENTRY(60)
		SIRQ_TABLE_ENTRY(61) SIRQ_TABLE_ENTRY(62)
		SIRQ_TABLE_ENTRY(63) SIRQ_TABLE_ENTRY(64)
		SIRQ_TABLE_ENTRY(65) SIRQ_TABLE_ENTRY(66)
		SIRQ_TABLE_ENTRY(67) SIRQ_TABLE_ENTRY(68)
		SIRQ_TABLE_ENTRY(69) SIRQ_TABLE_ENTRY(70)
		SIRQ_TABLE_ENTRY(71) SIRQ_TABLE_ENTRY(72)
		SIRQ_TABLE_ENTRY(73) SIRQ_TABLE_ENTRY(74)
		SIRQ_TABLE_ENTRY(75) SIRQ_TABLE_ENTRY(76)
		SIRQ_TABLE_ENTRY(77) SIRQ_TABLE_ENTRY(78)
		SIRQ_TABLE_ENTRY(79) SIRQ_TABLE_ENTRY(80)
		SIRQ_TABLE_ENTRY(81) SIRQ_TABLE_ENTRY(82)
		SIRQ_TABLE_ENTRY(83) SIRQ_TABLE_ENTRY(84)
		SIRQ_TABLE_ENTRY(85) SIRQ_TABLE_ENTRY(86)
		SIRQ_TABLE_ENTRY(87) SIRQ_TABLE_ENTRY(88)
		SIRQ_TABLE_ENTRY(89) SIRQ_TABLE_ENTRY(90)
		SIRQ_TABLE_ENTRY(91) SIRQ_TABLE_ENTRY(92)
		SIRQ_TABLE_ENTRY(93) SIRQ_TABLE_ENTRY(94)
		SIRQ_TABLE_ENTRY(95) SIRQ_TABLE_ENTRY(96)
		SIRQ_TABLE_ENTRY(97) SIRQ_TABLE_ENTRY(98)
		SIRQ_TABLE_ENTRY(99) SIRQ_TABLE_ENTRY(100)
		SIRQ_TABLE_ENTRY(101) SIRQ_TABLE_ENTRY(102)
		SIRQ_TABLE_ENTRY(103) SIRQ_TABLE_ENTRY(104)
		SIRQ_TABLE_ENTRY(105) SIRQ_TABLE_ENTRY(106)
		SIRQ_TABLE_ENTRY(107) SIRQ_TABLE_ENTRY(108)
		SIRQ_TABLE_ENTRY(109) SIRQ_TABLE_ENTRY(110)
		SIRQ_TABLE_ENTRY(111) SIRQ_TABLE_ENTRY(112)
		SIRQ_TABLE_ENTRY(113) SIRQ_TABLE_ENTRY(114)
		SIRQ_TABLE_ENTRY(115) SIRQ_TABLE_ENTRY(116)
		SIRQ_TABLE_ENTRY(117) SIRQ_TABLE_ENTRY(118)
		SIRQ_TABLE_ENTRY(119) SIRQ_TABLE_ENTRY(120)
		SIRQ_TABLE_ENTRY(121) SIRQ_TABLE_ENTRY(122)
		SIRQ_TABLE_ENTRY(123) SIRQ_TABLE_ENTRY(124)
		SIRQ_TABLE_ENTRY(125) SIRQ_TABLE_ENTRY(126)
		SIRQ_TABLE_ENTRY(127) SIRQ_TABLE_ENTRY(128)
	}
}
