#include <asm-generic/embox.lds.h>

SECTIONS {
	.rodata.embox.buildinfo : {
		buildinfo_begin = .;
		/* This file is generated by ./mk/gen_buildinfo.sh */
		INCLUDE "./build/base/gen/buildinfo.ld";
		buildinfo_end = .;
	}
}
